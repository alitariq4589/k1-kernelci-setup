## firmware/u-boot.its
```
/dts-v1/;

/ {
        description = "U-boot FIT image for k1x";
        #address-cells = <2>;
        fit,fdt-list = "of-list";

        images {
            uboot {
			    description = "U-Boot";
			    type = "standalone";
			    os = "U-Boot";
			    arch = "riscv";
			    compression = "none";
			    load = <0x0 0x00200000>;
			    data = /incbin/("./u-boot-nodtb.bin");
			    hash-1 {
			    	algo = "crc32";
			    };
		};
                
            fdt_2 {
			    description = "k1-x_deb1";
			    type = "flat_dt";
			    compression = "none";
			    data = /incbin/("./k1-x_deb1.dtb");
			    hash-1 {
				    algo = "crc32";
			    };
		    };
        };

        configurations {
                default = "conf_14";
                conf_14 {
                        description = "k1-x_deb1";
                        loadables = "uboot";
                        fdt = "fdt_2";
                };
        };
};
```

## firmware/uboot-opensbi.its
```
/dts-v1/;

/ {
        description = "U-boot and opensbi FIT image for k1x";
        #address-cells = <2>;
        fit,fdt-list = "of-list";

	images {
		uboot {
			description = "U-Boot";
			type = "standalone";
			os = "U-Boot";
			arch = "riscv";
			compression = "none";
			load = <0x0 0x00200000>;
			data = /incbin/("./u-boot-nodtb.bin");
			hash-1 {
				algo = "crc32";
			};
		};

                opensbi {
                        description = "OpenSBI fw_dynamic Firmware";
                        type = "firmware";
                        os = "opensbi";
                        arch = "riscv";
                        compression = "none";
                        load = <0x0 0x0>;
                        entry = <0x0 0x0>;
                        data = /incbin/("./fw_dynamic_buildroot.bin");
                        hash-1 {
				algo = "crc32";
			};
                };
                fdt_1 {
			description = "k1-x_evb";
			type = "flat_dt";
			compression = "none";
			data = /incbin/("../dtb/k1-x_evb.dtb");
			hash-1 {
				algo = "crc32";
			};
		};
		fdt_2 {
			description = "k1-x_deb1";
			type = "flat_dt";
			compression = "none";
			data = /incbin/("../dtb/k1-x_deb1.dtb");
			hash-1 {
				algo = "crc32";
			};
		};
		fdt_3 {
			description = "k1-x_deb2";
			type = "flat_dt";
			compression = "none";
			data = /incbin/("../dtb/k1-x_deb2.dtb");
			hash-1 {
				algo = "crc32";
			};
		};
		fdt_4 {
			description = "k1-x_hs450";
			type = "flat_dt";
			compression = "none";
			data = /incbin/("../dtb/k1-x_hs450.dtb");
			hash-1 {
				algo = "crc32";
			};
		};
		fdt_5 {
			description = "k1-x_kx312";
			type = "flat_dt";
			compression = "none";
			data = /incbin/("../dtb/k1-x_kx312.dtb");
			hash-1 {
				algo = "crc32";
			};
		};
		fdt_6 {
			description = "k1-x_MINI-PC";
			type = "flat_dt";
			compression = "none";
			data = /incbin/("../dtb/k1-x_MINI-PC.dtb");
			hash-1 {
				algo = "crc32";
			};
		};
		fdt_7 {
			description = "k1-x_mingo";
			type = "flat_dt";
			compression = "none";
			data = /incbin/("../dtb/k1-x_mingo.dtb");
			hash-1 {
				algo = "crc32";
			};
		};
		fdt_8 {
			description = "k1-x_MUSE-N1";
			type = "flat_dt";
			compression = "none";
			data = /incbin/("../dtb/k1-x_MUSE-N1.dtb");
			hash-1 {
				algo = "crc32";
			};
		};
		fdt_9 {
			description = "k1-x_MUSE-Pi";
			type = "flat_dt";
			compression = "none";
			data = /incbin/("../dtb/k1-x_MUSE-Pi.dtb");
			hash-1 {
				algo = "crc32";
			};
		};
		fdt_10 {
			description = "k1-x_milkv-jupiter";
			type = "flat_dt";
			compression = "none";
			data = /incbin/("../dtb/k1-x_milkv-jupiter.dtb");
			hash-1 {
				algo = "crc32";
			};
		};
		fdt_11 {
			description = "k1-x_MUSE-Book.dtb";
			type = "flat_dt";
			compression = "none";
			data = /incbin/("../dtb/k1-x_MUSE-Book.dtb");
			hash-1 {
				algo = "crc32";
			};
		};
		fdt_12 {
			description = "m1-x_milkv-jupiter";
			type = "flat_dt";
			compression = "none";
			data = /incbin/("../dtb/m1-x_milkv-jupiter.dtb");
			hash-1 {
				algo = "crc32";
			};
		};
		fdt_13 {
			description = "k1-x_lpi3a";
			type = "flat_dt";
			compression = "none";
			data = /incbin/("../dtb/k1-x_lpi3a.dtb");
			hash-1 {
				algo = "crc32";
			};
		};
		fdt_14 {
			description = "k1-x_MUSE-Card";
			type = "flat_dt";
			compression = "none";
			data = /incbin/("../dtb/k1-x_MUSE-Card.dtb");
			hash-1 {
				algo = "crc32";
			};
		};
		fdt_15 {
			description = "k1-x_MUSE-Paper";
			type = "flat_dt";
			compression = "none";
			data = /incbin/("../dtb/k1-x_MUSE-Paper.dtb");
			hash-1 {
				algo = "crc32";
			};
		};
		fdt_16 {
			description = "k1-x_MUSE-Paper-mini-4g";
			type = "flat_dt";
			compression = "none";
			data = /incbin/("../dtb/k1-x_MUSE-Paper-mini-4g.dtb");
			hash-1 {
				algo = "crc32";
			};
		};
	};
        configurations {
		default = "conf_2";
		conf_1 {
			description = "k1-x_evb";
                        firmware = "opensbi";
			loadables = "uboot";
			fdt = "fdt_1";
		};
		conf_2 {
			description = "k1-x_deb1";
                        firmware = "opensbi";
			loadables = "uboot";
			fdt = "fdt_2";
		};
		conf_3 {
			description = "k1-x_deb2";
                        firmware = "opensbi";
			loadables = "uboot";
			fdt = "fdt_3";
		};
		conf_4 {
			description = "k1-x_hs450";
                        firmware = "opensbi";
			loadables = "uboot";
			fdt = "fdt_4";
		};
		conf_5 {
			description = "k1-x_kx312";
                        firmware = "opensbi";
			loadables = "uboot";
			fdt = "fdt_5";
		};
		conf_6 {
			description = "k1-x_MINI-PC";
                        firmware = "opensbi";
			loadables = "uboot";
			fdt = "fdt_6";
		};
		conf_7 {
			description = "k1-x_mingo";
                        firmware = "opensbi";
			loadables = "uboot";
			fdt = "fdt_7";
		};
		conf_8 {
			description = "k1-x_MUSE-N1";
                        firmware = "opensbi";
			loadables = "uboot";
			fdt = "fdt_8";
		};
		conf_9 {
			description = "k1-x_MUSE-Pi";
                        firmware = "opensbi";
			loadables = "uboot";
			fdt = "fdt_9";
		};
		conf_10 {
			description = "k1-x_milkv-jupiter";
                        firmware = "opensbi";
			loadables = "uboot";
			fdt = "fdt_10";
		};
		conf_11 {
			description = "k1-x_MUSE-Book";
                        firmware = "opensbi";
			loadables = "uboot";
			fdt = "fdt_11";
		};
		conf_12 {
			description = "m1-x_milkv-jupiter";
                        firmware = "opensbi";
			loadables = "uboot";
			fdt = "fdt_12";
		};
		conf_13 {
			description = "k1-x_lpi3a";
                        firmware = "opensbi";
			loadables = "uboot";
			fdt = "fdt_13";
		};
		conf_14 {
			description = "k1-x_MUSE-Card";
                        firmware = "opensbi";
			loadables = "uboot";
			fdt = "fdt_14";
		};
		conf_15 {
			description = "k1-x_MUSE-Paper";
                        firmware = "opensbi";
			loadables = "uboot";
			fdt = "fdt_15";
		};
		conf_16 {
			description = "k1-x_MUSE-Paper-mini-4g";
                        firmware = "opensbi";
			loadables = "uboot";
			fdt = "fdt_16";
		};
	};
};
```
